## firmware/esp32s3/main/Kconfig.projbuild
```kconfig
menu "EP-DJ3000"

    config EPDJ_HW_REV
        int "Hardware revision reported in Info.hwRev"
        range 0 255
        default 1

    choice EPDJ_BOARD_REV
        prompt "ESP32-S3-DevKitC-1 board revision (decides the status LED pin)"
        default EPDJ_BOARD_DEVKITC_1_V1_1
        help
            The on-board WS2812 is on GPIO38 on v1.1 boards (the ones sold now) and on GPIO48 on v1.0. The
            revision is printed on the board. Choosing wrong leaves the status LED dark and changes nothing
            else; the boot log line "led: ... on GPIO.." says which pin was driven. For another board, edit
            kStatusLed in epdj_hal/board_pins.h.

        config EPDJ_BOARD_DEVKITC_1_V1_1
            bool "DevKitC-1 v1.1 (status LED on GPIO38)"
        config EPDJ_BOARD_DEVKITC_1_V1_0
            bool "DevKitC-1 v1.0 (status LED on GPIO48)"
    endchoice

    menu "Platter and sensors"

        choice EPDJ_PLATTER_DEFAULT
            prompt "Platter source on a unit with no saved configuration"
            default EPDJ_PLATTER_AS5600
            help
                Only the first-boot default: the setting is a live config key (platterSource) the
                macOS app can change and save. A unit that already saved its configuration keeps what it
                saved, including TOUCH_RING from before contract v1.3 (LOAD_DEFAULTS, then SAVE_CONFIG).

            config EPDJ_PLATTER_AS5600
                bool "AS5600 magnetic encoder under a free-spinning platter (the default build)"
            config EPDJ_PLATTER_TOUCH_RING
                bool "EXPERIMENTAL: segmented conductive-PLA ring on touch pads (finger-slide scratching)"
            config EPDJ_PLATTER_HOLD_ONLY
                bool "Touch/hold detection only, no rotation"
        endchoice

        config EPDJ_TOUCH_PAD_COUNT
            int "Number of touch pads wired (0 = none)"
            range 0 8
            default 1
            help
                Pads are GPIO4.. in order, sector 0 first (board_pins.h). With the AS5600 platter (the
                default) wire ONE pad: GPIO4 is the hold pad, which supplies the touch note and tap
                detection while the encoder supplies the motion. 0 means no hold pad: jog still works
                but the unit never sends a touch note, so DJ apps never enter scratch mode. For the
                experimental touch ring wire 3 to 8 pads (8 for the full ring).

        config EPDJ_TOUCH_SCAN_TARGET_US
            int "Touch: target duration of one scan of all pads (us, 0 = no auto-range)"
            range 0 20000
            default 800
            help
                The S3 measures its pads one after another, and the engine reads them every millisecond.
                A scan longer than that leaves every pad's value stale for several reads and samples the
                pads at different instants, which smears the finger angle. At boot the firmware times the
                scan at two settings and picks the number of charge/discharge cycles that makes it take
                about this long (a finger on a pad lengthens its measurement, hence the headroom below
                1000 us). The price is coarser counts: check the finger rise against the idle noise
                (hardware/PLATTER.md). 0 turns this off and uses the cycle count below as is.
                Needs two or more pads.

        config EPDJ_TOUCH_CHARGE_DISCHARGE_TIMES
            int "Touch measurement: charge/discharge cycles per pad (the most auto-range may use)"
            range 1 65535
            default 500
            help
                The raw count is the RTC_FAST clock cycles those cycles take, so it grows with pad
                capacitance and with this value, and so does the time one scan of all pads takes. With
                EPDJ_TOUCH_SCAN_TARGET_US set this is the upper limit and the setting the scan is first
                timed at; with the target at 0 it is used as it is. At 500 a typical pad takes over a
                millisecond, so eight pads scan in about ten.

        config EPDJ_TOUCH_INTERVAL_CYCLES
            int "Touch measurement: sleep between scans (RTC_SLOW cycles)"
            range 0 65535
            default 16

        config EPDJ_ADC_OVERSAMPLE
            int "ADC conversions averaged per fader/knob sample"
            range 1 32
            default 8
            help
                The upper limit: at boot the firmware times one conversion and the AS5600 read, and lowers
                the count so that fader, knob and encoder together take at most 400 us of each
                millisecond (the encoder read comes off the top). Each ADC conversion runs with interrupts
                off on the core that also serves USB. 8 trades part of that budget for roughly 3x less ADC
                noise than a single read.

        config EPDJ_AS5600_ENABLE
            bool "Probe for an AS5600 encoder on I2C at boot (SDA GPIO21, SCL GPIO47, address 0x36)"
            default y
            help
                Needed for the default AS5600 platter: with it off, platterSource AS5600 has no encoder to
                read and the unit sends no jog. The boot log says whether the chip answered and how the
                magnet looks. A chip that does not answer is asked again every 500 ms while the AS5600 is the
                platter, so a wire fixed after power-up is found without a reboot.

        config EPDJ_AS5600_FILTERED_ANGLE
            bool "Read the AS5600's filtered ANGLE register (0x0E) instead of RAW ANGLE (0x0C)"
            depends on EPDJ_AS5600_ENABLE
            default y
            help
                On: the firmware writes the chip's CONF register at start-up (watchdog off, hysteresis 0, slow
                filter setting 0 = 16x, fast-filter threshold setting 7 = 10 LSB: the settings of the original
                Field Jog firmware this deck's shell was drawn for) and reads ANGLE, the scaled output that the
                filters belong to. The slow filter quietens a platter at rest; the fast-filter threshold lets
                movement above 10 LSB through without the slow filter's lag. Off: reads RAW ANGLE, documented as
                unscaled and unmodified, so no filtering at all (CONF is still written, harmlessly).
                ANGLE is also scaled by the chip's ZPOS/MPOS/MANG registers: a chip someone burned with a
                limited range gives fewer than 1024 ticks a lap, and then this must be off.
                This is the bench A/B switch: whether the filter helps or only adds lag has not been measured on a
                real chip (docs/BRINGUP.md, hardware/WIRING.md). Rebuild, flash, compare the idle angle in the
                once-a-second sens: line and how a fast scratch feels.

    endmenu

    menu "USB"

        config EPDJ_USB_AUDIO
            bool "Add a USB Audio 1.0 output function when a DAC is present"
            default y
            help
                Without it the unit is MIDI-only whatever the DAC strap says. The function exists only if
                the DAC is detected (or dacMode forces it) at boot: USB descriptors cannot change later.

        choice EPDJ_AUDIO_RING
            prompt "Audio buffer between USB and the DAC"
            default EPDJ_AUDIO_RING_2048
            help
                Half of it is the playback delay the rate-matching loop aims for. 2048 frames = 21 ms
                of buffering; 1024 halves the latency but gives USB timing less room.

            config EPDJ_AUDIO_RING_1024
                bool "1024 frames (10.7 ms target delay)"
            config EPDJ_AUDIO_RING_2048
                bool "2048 frames (21 ms target delay)"
            config EPDJ_AUDIO_RING_4096
                bool "4096 frames (43 ms target delay)"
        endchoice

        config EPDJ_AUDIO_RING_FRAMES
            int
            default 1024 if EPDJ_AUDIO_RING_1024
            default 2048 if EPDJ_AUDIO_RING_2048
            default 4096 if EPDJ_AUDIO_RING_4096

        config EPDJ_DAC_PROBE_I2C
            bool "Also probe known I2S codec I2C addresses when detecting a DAC"
            default n
            help
                The DAC-present strap pin is always checked. This adds a scan of a few codec control
                addresses on the shared I2C bus (ES8388, ES8311/TLV320DAC3100, WM8960, PCM512x).

    endmenu

    menu "MIDI and radio"

        config EPDJ_TRS_MIDI
            bool "3.5 mm TRS MIDI on UART1"
            default y

        config EPDJ_LINK
            bool "ESP-NOW link to the other deck"
            default y

        config EPDJ_LINK_CHANNEL
            int "Wi-Fi channel for the link (both decks must match)"
            depends on EPDJ_LINK
            range 1 13
            default 1

        config EPDJ_LINK_GROUP
            int "Build-time rig id (default for the linkGroup config key)"
            depends on EPDJ_LINK
            range 0 255
            default 0
            help
                Units with different rig ids ignore each other. This is only the fallback: the linkGroup
                config key (SysEx, live, saved with SAVE_CONFIG) wins whenever it is non-zero, so a value set
                from the app overrides this one. Because 0 means "no override", a unit built with a non-zero
                value here cannot be put back on group 0 over SysEx (docs/LINK.md section 11).

    endmenu

    choice EPDJ_FIRST_BOOT_DECK
        prompt "Deck on a unit with no saved configuration"
        default EPDJ_FIRST_BOOT_DECK_A
        help
            Flash one image with B for the second unit, or swap later with CUE+REV held 5 s.

        config EPDJ_FIRST_BOOT_DECK_A
            bool "Deck A"
        config EPDJ_FIRST_BOOT_DECK_B
            bool "Deck B"
    endchoice

    menu "Diagnostics"

        config EPDJ_LOG_SENSORS
            bool "Log raw fader, knob, angle and touch counts once a second"
            default y

        config EPDJ_LOG_PERIOD_S
            int "Seconds between statistics lines (0 = off)"
            range 0 3600
            default 10

    endmenu

endmenu
```
